## kernel/Kconfig
```kconfig
menu "MySU"

config MYSU
	tristate "MySU function support"
	depends on KPROBES && EXT4_FS
	default y
	help
	  Enable kernel-level root privileges on Android System.
	  Requires CONFIG_KPROBES for kernel hooking support.
	  Requires CONFIG_EXT4_FS for `ext4_unregister_sysfs`.
	  To compile as a module, choose M here: the
	  module will be called mysu.

config MYSU_DEBUG
	bool "MySU debug mode"
	depends on MYSU
	default n
	help
	  Enable MySU debug mode.

config MYSU_DISABLE_MANAGER
	bool "Disable MySU manager integration"
	depends on MYSU
	default n
	help
	  Disable manager APK detection and manager-specific handling.
	  Root will be used in place of manager-only functionality.

config MYSU_DISABLE_POLICY
	bool "Disable MySU policy profiles"
	depends on MYSU
	default n
	help
	  Disable per-app root/non-root profile customization.
	  Escalation will always use the default full root profile, and
	  non-root handling will follow the global umount policy only.

config MYSU_X86_PATCH_SYSCALL_DISPATCHER
	bool "Dynamically patch x64's hardened syscall dispatcher to support syscall hooks"
	depends on MYSU && X86_64
	default n
	help
	  Dynamically patch x64's hardened syscall dispatcher to support syscall hooks. This is a
	  replacement for a kernel source code patch, and is useful for x86_64 LKM mode.

menuconfig MYSU_MYSUFS
	bool "MYSUFS (SU File System) Kernel Anti-Detection"
	depends on MYSU
	default y
	help
	  Enable kernel-level anti-detection subsystem (MYSUFS) providing deep VFS path cloaking,
	  mount hiding, stat/statfs spoofing, open redirection, maps hiding, and signature spoofing.

if MYSU_MYSUFS

config MYSU_MYSUFS_SUS_PATH
	bool "Enable MYSUFS path cloaking"
	default y
	help
	  Hide specific paths from unauthorized processes via VFS dcache/lookup filtering.

config MYSU_MYSUFS_SUS_MOUNT
	bool "Enable MYSUFS mount cloaking"
	default y
	help
	  Hide internal mounts and unshared mount namespaces from non-root processes.

config MYSU_MYSUFS_SUS_KSTAT
	bool "Enable MYSUFS stat spoofing"
	default y
	help
	  Spoof inode attributes (dev, ino, times, size) for cloaked files.

config MYSU_MYSUFS_OPEN_REDIRECT
	bool "Enable MYSUFS open redirection"
	default y
	help
	  Redirect file opens for specific sensitive paths to safe spoof targets.

config MYSU_MYSUFS_SUS_MAP
	bool "Enable MYSUFS memory map hiding"
	default y
	help
	  Hide memory-mapped regions in /proc/[pid]/maps and smaps.

config MYSU_MYSUFS_SPOOF_UNAME
	bool "Enable MYSUFS uname spoofing"
	default y
	help
	  Allow spoofing kernel release and version strings returned by uname().

config MYSU_MYSUFS_SPOOF_CMDLINE_OR_BOOTCONFIG
	bool "Enable MYSUFS cmdline spoofing"
	default y
	help
	  Allow spoofing /proc/cmdline to redact verified boot and root flags.

config MYSU_MYSUFS_ENABLE_LOG
	bool "Enable MYSUFS kernel logging"
	default n
	help
	  Enable verbose logging for MYSUFS operations.

config MYSU_MYSUFS_HIDE_KSU_MYSUFS_SYMBOLS
	bool "Hide MySU and MYSUFS symbols in /proc/kallsyms"
	default y
	help
	  Filter MySU, KSU, and MYSUFS symbols from /proc/kallsyms.

endif # MYSU_MYSUFS

endmenu
```
